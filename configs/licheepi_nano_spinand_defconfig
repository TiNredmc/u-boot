## configs/licheepi_nano_spinand_defconfig
```kconfig
CONFIG_ARM=y
CONFIG_ARCH_SUNXI=y

CONFIG_ENV_IS_NOWHERE=y
CONFIG_ENV_IS_IN_FAT=n

CONFIG_SYS_TEXT_BASE=0x80000000

CONFIG_MACH_SUNIV=y
CONFIG_DRAM_CLK=156
CONFIG_DRAM_ZQ=0

# CONFIG_VIDEO_SUNXI is not set
CONFIG_DEFAULT_DEVICE_TREE="suniv-f1c100s-licheepi-nano"

# SPL STUFFS
CONFIG_SPL=y
CONFIG_SPL_SPI_SUNXI=y

# CONFIG_CMD_FLASH is not set
# CONFIG_CMD_FPGA is not set

#SPI STUFFS
CONFIG_SPI=y
CONFIG_DM_SPI=y
CONFIG_SPI_SUNXI=y
CONFIG_CMD_SPI=y
CONFIG_SF_DEFAULT_SPEED=6000000

# (SPI)FLASH STUFFS
CONFIG_DM_SPI_FLASH=y
CONFIG_SPI_FLASH=y
CONFIG_SPI_FLASH_BAR=y
CONFIG_SPI_FLASH_WINBOND=y
CONFIG_CMD_SF=n
CONFIG_SPI_FLASH_USE_4K_SECTORS=n

# MTD STUFFS
CONFIG_MTD=y
CONFIG_DM_MTD=y
CONFIG_MTD_SPI_NAND=y
CONFIG_CMD_MTD=y


# Force not to use the LZO compression.
CONFIG_LZO=n
CONFIG_CMD_UBI=n

# Force not to do any special hashing and CRC stuffs 
CONFIG_FIT_ENABLE_SHA256_SUPPORT=n
CONFIG_SHA256=n
CONFIG_CMD_CRC32=n
CONFIG_CMD_LOADB=n
CONFIG_CMD_LOADS=n

# Force not to use FIT Image
CONFIG_FIT=n

# I'm not setting up the MMC stuffs yet, so no MMC for now.
CONFIG_MMC=n
```
